## boards/shields/anywhy_flake/Kconfig.shield
```kconfig
# Copyright (c) 2020 Pete Johanson
# SPDX-License-Identifier: MIT

config SHIELD_ANYWHY_FLAKE_LEFT
	def_bool $(shields_list_contains,anywhy_flake_left)

config SHIELD_ANYWHY_FLAKE_RIGHT
	def_bool $(shields_list_contains,anywhy_flake_right)
```
