#include "anywhy_flake.dtsi"

&kscan0 {
    compatible = "zmk,kscan-gpio-matrix";
    wakeup-source;

    col-gpios
        = <&gpio0 11 GPIO_ACTIVE_HIGH>
        , <&gpio0 10 GPIO_ACTIVE_HIGH>
        , <&gpio1 11 GPIO_ACTIVE_HIGH>
        , <&gpio1 13 GPIO_ACTIVE_HIGH>
        , <&gpio1 15 GPIO_ACTIVE_HIGH>
        , <&gpio1 4 GPIO_ACTIVE_HIGH>
        ;

    row-gpios
        = <&gpio0 31  (GPIO_ACTIVE_HIGH | GPIO_PULL_DOWN)>
        , <&gpio0 29  (GPIO_ACTIVE_HIGH | GPIO_PULL_DOWN)>
        , <&gpio0 2 (GPIO_ACTIVE_HIGH | GPIO_PULL_DOWN)>
        , <&gpio0 9 (GPIO_ACTIVE_HIGH | GPIO_PULL_DOWN)>
        , <&gpio1 6 (GPIO_ACTIVE_HIGH | GPIO_PULL_DOWN)>
        ;
};

&large_layout {
    kscan = <&kscan0>;
};

#include <input/processors.dtsi>
#include "mouse_tp.dtsi"

// We have the trackpoint on the right peripheral split, so
// set the actual trackpoint as the device for the peripheral. 
&tpoint_split { 
    device = <&mouse_ps2>; 
    input-processors = <&zip_xy_swap_mapper>;
};
