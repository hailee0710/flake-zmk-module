## boards/shields/anywhy_flake/Kconfig.defconfig
```kconfig
if SHIELD_ANYWHY_FLAKE_DONGLE

config ZMK_KEYBOARD_NAME
    default "Flake TTP"

config ZMK_SPLIT_ROLE_CENTRAL
    default y

endif


if SHIELD_ANYWHY_FLAKE_LEFT || SHIELD_ANYWHY_FLAKE_RIGHT || SHIELD_ANYWHY_FLAKE_DONGLE

config ZMK_SPLIT
	default y

endif
```

## config/west.yml
```yaml
manifest:
  remotes:
    - name: zmkfirmware
      url-base: https://github.com/zmkfirmware
    - name: mctechnology17
      url-base: https://github.com/mctechnology17
    - name: badjeff
      url-base: https://github.com/badjeff
    - name: hailee0710
      url-base: https://github.com/hailee0710
  projects:
    - name: zmk
      remote: zmkfirmware
      revision: v0.3
      import: app/west.yml
    # Module for PS/2 mouse & TP driver
    - name: kb_zmk_ps2_mouse_trackpoint_driver
      remote: badjeff
      revision: main
    - name: zmk-dongle-eyes
      remote: hailee0710
      revision: v0.3-lvgl8-framebuffer-port
  self:
    path: config
```

## src/Kconfig
```kconfig
DT_COMPAT_ZMK_INPUT_PROCESSOR_ACCELERATION := zmk,input-processor-acceleration

config ZMK_INPUT_PROCESSOR_ACCELERATION
    bool "Pointer Acceleration Input Processor"
    default y
    depends on DT_HAS_ZMK_INPUT_PROCESSOR_ACCELERATION_ENABLED
```
